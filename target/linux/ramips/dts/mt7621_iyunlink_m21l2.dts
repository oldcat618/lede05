// SPDX-License-Identifier: GPL-2.0-or-later OR MIT

#include "mt7621_iyunlink_m21series.dtsi"

/ {
	compatible = "iyunlink,m21l2", "mediatek,mt7621-soc";
	model = "M21L2";

};

&pcie {
	status = "disabled";
};